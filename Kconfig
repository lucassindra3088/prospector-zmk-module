## Kconfig
```kconfig
choice PROSPECTOR_STATUS_SCREEN_LAYOUT
    prompt "Status screen layout"
    default PROSPECTOR_STATUS_SCREEN_CLASSIC

config PROSPECTOR_STATUS_SCREEN_CLASSIC
    bool "Classic layout"
    help
        Standard Prospector status screen

config PROSPECTOR_STATUS_SCREEN_RADII
    bool "Radii layout"
    help
        Colorful grid layout with rounded widgets

config PROSPECTOR_STATUS_SCREEN_FIELD
    bool "Field layout"
    help
        Minimal layout with flowing typing activity visualization

config PROSPECTOR_STATUS_SCREEN_OPERATOR
    bool "Operator layout"
    help
        Technical and information dense layout

endchoice

config PROSPECTOR_ROTATE_DISPLAY_180
    bool "Rotate the display 180 degrees"
    default n

config PROSPECTOR_SHOW_MODIFIERS
    bool "Display modifier key indicators (Cmd, Opt, Ctrl, Shift)"
    default y

config PROSPECTOR_SHOW_INACTIVE_MODIFIERS
    bool "Show inactive modifier indicators (dim when not pressed)"
    default y
    depends on PROSPECTOR_SHOW_MODIFIERS
    help
      When enabled, inactive modifiers are shown with a dim color.
      When disabled, inactive modifiers are hidden completely.
      Only affects classic and field layouts.

config PROSPECTOR_MODIFIER_ORDER
    string "Modifier display order"
    default "GACS"
    depends on PROSPECTOR_SHOW_MODIFIERS
    help
      Order of modifier indicators. Use exactly 4 characters:
      G=GUI/Cmd, A=Alt/Opt, C=Control, S=Shift.
      Each character must appear exactly once.

choice PROSPECTOR_MODIFIER_OS
    prompt "Modifier key style"
    default PROSPECTOR_MODIFIER_OS_MAC
    depends on PROSPECTOR_SHOW_MODIFIERS

config PROSPECTOR_MODIFIER_OS_GENERIC
    bool "Generic (CTRL, ALT, GUI, SHFT)"

config PROSPECTOR_MODIFIER_OS_WINDOWS
    bool "Windows"

config PROSPECTOR_MODIFIER_OS_MAC
    bool "Mac"

endchoice

config PROSPECTOR_USE_AMBIENT_LIGHT_SENSOR
    bool "Use ambient light sensor for auto brightness"
    default y

config PROSPECTOR_FIXED_BRIGHTNESS
    int "Fixed display brightness"
    default 50
    range 1 100
    depends on !PROSPECTOR_USE_AMBIENT_LIGHT_SENSOR

config PROSPECTOR_DISPLAY_SLEEP_ENABLE
    bool "Turn off display on idle"
    default n

config PROSPECTOR_DISPLAY_IDLE_TIMEOUT_MS
    int "Display idle timeout in ms"
    default 30000
    depends on PROSPECTOR_DISPLAY_SLEEP_ENABLE

config PROSPECTOR_DISPLAY_SLEEP_USE_PM
    bool "Use Zephyr PM to suspend the display (SLEEP_IN)"
    default n
    depends on PROSPECTOR_DISPLAY_SLEEP_ENABLE && PM_DEVICE

config PROSPECTOR_LAYER_NAME_UPPERCASE
    bool "Display layer names in uppercase"
    default y
    help
      When enabled, layer names will be converted to uppercase for display.
```
